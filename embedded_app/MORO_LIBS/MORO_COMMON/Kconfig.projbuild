## embedded_app/MORO_LIBS/MORO_COMMON/Kconfig.projbuild
```kconfig
menu "MORO_COMMON"

    choice MORO_LOG_LEVEL
        bool "Senseway log level"
        default MORO_LOG_LEVEL_WARNING
        help
            Specify how much output to see in logs by default.

        config MORO_LOG_LEVEL_NONE
            bool "No output"
        config MORO_LOG_LEVEL_ERROR
            bool "Error"
        config MORO_LOG_LEVEL_WARNING
            bool "Warning"
        config MORO_LOG_LEVEL_INFO
            bool "Info"
        config MORO_LOG_LEVEL_DEBUG
            bool "Debug"
        config MORO_LOG_LEVEL_VERBOSE
            bool "Verbose"
    endchoice

    config MORO_LOG_LEVEL
        int
        default 0 if MORO_LOG_LEVEL_NONE
        default 1 if MORO_LOG_LEVEL_ERROR
        default 2 if MORO_LOG_LEVEL_WARNING
        default 3 if MORO_LOG_LEVEL_INFO
        default 4 if MORO_LOG_LEVEL_DEBUG
        default 5 if MORO_LOG_LEVEL_VERBOSE

    choice MORO_LOG_COLOR_LEVEL
        bool "Color level of logs"
        default MORO_LOG_COLORED
        help
            if we are printing to terminal open it, otherwise leave it non-colored

        config MORO_LOG_COLORED
            bool "Colored output"
        config MORO_LOG_NO_COLOR
            bool "No color at the output"
    endchoice

    config MORO_LOG_COLOR_LEVEL
        int
        default 0 if MORO_LOG_NO_COLOR
        default 1 if MORO_LOG_COLORED  

endmenu
```
